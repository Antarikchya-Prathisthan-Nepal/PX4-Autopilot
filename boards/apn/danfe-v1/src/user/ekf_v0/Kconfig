## boards/apn/danfe-v1/src/user/ekf_v0/Kconfig
```kconfig
menuconfig USER_EKF_V0
	bool "ekf_estimator"
	default n
	---help---
		Enable support for ekf estimator for Attitude determination
```

## boards/apn/phi-v1/src/user/mt25ql_flash/Kconfig
```kconfig
menuconfig USER_MT25QL_FLASH
	bool "mt25ql_flash"
	default n
	---help---
		user support for operating flash memory
```

## boards/apn/phi-v1/src/user/mylogger/Kconfig
```kconfig
menuconfig USER_MYLOGGER
	bool "mylogger"
	default n
	---help---
		Disable support for mylogger
```

## src/examples/ftdi_comm_modules/Kconfig
```kconfig
menuconfig EXAMPLES_FTDI_COMM_MODULES
	bool "ftdi_comm_modules"
	default n
	---help---
		Enable support for ftdi_communication
```

## src/examples/hk_data/Kconfig
```kconfig
menuconfig EXAMPLES_HK_DATA
	bool "hk_data"
	default n
	---help---
		Enable support for hk_data
```
